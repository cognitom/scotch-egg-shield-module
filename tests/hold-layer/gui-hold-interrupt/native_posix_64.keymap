#include "../../windmill.dtsi"

/* Win を押してすぐ ぬ を押しても、ぬ は英数レイヤーで引かれる
 * (windmill の HoldLayer.gui_hold_by_interrupt_resolves_on_alpha)。
 * ぬ は つ のタップ・ホールドの判定を待つ。つ を押したまま 150ms に達すると、ぬ を押して
 * いたのでホールド (Win + 英数レイヤー) に決まり、待っていた ぬ は英数の q になる */
&kscan {
    events = <
        TO_KANA
        ZMK_MOCK_PRESS(3,1,1)
        ZMK_MOCK_PRESS(0,1,120)
        ZMK_MOCK_RELEASE(0,1,120)
        ZMK_MOCK_RELEASE(3,1,120)
    >;
};

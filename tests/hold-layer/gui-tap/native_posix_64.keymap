#include "../../windmill.dtsi"

/* Win (つ) を短く押して離せばタップで「つ」(z) が出て、かなのまま
 * (windmill の HoldLayer.tap_stays_on_kana)。続く ぬ がかなの 1 で出ることを見る */
&kscan {
    events = <
        TO_KANA
        TAP(3,1)
        TAP(0,1)
    >;
};

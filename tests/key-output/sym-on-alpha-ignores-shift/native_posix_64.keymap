#include "../../windmill.dtsi"

/* 記号レイヤーでは Shift が効かない (windmill の KeyOutputJis.sym_layer_on_alpha_ignores_shift)。
 * 英数ベースで右の SandS を押していても同じ文字が出る。
 * Shift の要らない数字などは右Shift を隠して送り、要るものは右Shift をそのまま使う。
 * 右の親指の位置 (記号レイヤーでは「?」) は押したままなので叩かない */
&kscan {
    events = <
        ZMK_MOCK_PRESS(3,6,250)
        ZMK_MOCK_PRESS(3,4,250)
        /* 1 2 3 4 5 6 7 8 9 0 */
        TAP(0,1) TAP(0,2) TAP(0,3) TAP(0,4) TAP(0,5) TAP(0,6) TAP(0,7) TAP(0,8) TAP(0,9) TAP(0,10)
        /* ! @ # $ % ^ & * ( ) ` */
        TAP(1,1) TAP(1,2) TAP(1,3) TAP(1,4) TAP(1,5) TAP(1,6) TAP(1,7) TAP(1,8) TAP(1,9) TAP(1,10) TAP(1,11)
        /* = + - _ [ ] ~ { } */
        TAP(2,1) TAP(2,2) TAP(2,3) TAP(2,4) TAP(2,5) TAP(2,6) TAP(2,7) TAP(2,8) TAP(2,9)
        /* | */
        TAP(3,5)
        ZMK_MOCK_RELEASE(3,4,100)
        ZMK_MOCK_RELEASE(3,6,200)
    >;
};

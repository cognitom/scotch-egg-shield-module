#include "../../windmill.dtsi"

/* 左の親指 (こ) のホールドでも同じ (windmill の
 * KeyOutputJis.kana_shift_layer_with_left_thumb)。Shift の要る文字は押されている
 * 左Shift をそのまま使い、足し直さない。相方の み の位置 (空) は親指の組 (7/9) なので
 * 叩かない */
&kscan {
    events = <
        TO_KANA
        ZMK_MOCK_PRESS(3,5,250)
        /* ぬ ふ ぁ ぅ ぇ ぉ ゃ ゅ ょ を */
        TAP(0,1) TAP(0,2) TAP(0,3) TAP(0,4) TAP(0,5) TAP(0,6) TAP(0,7) TAP(0,8) TAP(0,9) TAP(0,10)
        /* た へ ぃ む か ん ほ に 「 」 ゜ */
        TAP(1,1) TAP(1,2) TAP(1,3) TAP(1,4) TAP(1,5) TAP(1,6) TAP(1,7) TAP(1,8) TAP(1,9) TAP(1,10) TAP(1,11)
        /* っ と し は き く ま 、 。 ・ ー */
        TAP(2,1) TAP(2,2) TAP(2,3) TAP(2,4) TAP(2,5) TAP(2,6) TAP(2,7) TAP(2,8) TAP(2,9) TAP(2,10) TAP(2,11)
        /* っ さ そ ひ ？ 、 。 ・ ろ */
        TAP(3,1) TAP(3,2) TAP(3,3) TAP(3,4) TAP(3,7) TAP(3,8) TAP(3,9) TAP(3,10) TAP(3,11)
        ZMK_MOCK_RELEASE(3,5,200)
    >;
};

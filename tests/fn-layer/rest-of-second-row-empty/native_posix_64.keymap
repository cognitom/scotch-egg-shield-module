#include "../../windmill.dtsi"

/* F11 / F12 より右の2段目には何も置いていない。ホストへは何も出ない (windmill の
 * FnLayer.rest_of_second_row_is_empty) */
&kscan {
    events = <
        ZMK_MOCK_PRESS(3,3,250)
        TAP(1,3) TAP(1,4) TAP(1,5) TAP(1,6) TAP(1,7) TAP(1,8) TAP(1,9) TAP(1,10) TAP(1,11)
        ZMK_MOCK_RELEASE(3,3,120)
    >;
};

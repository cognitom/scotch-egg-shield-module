#include "../../windmill.dtsi"

/* MY_ANDR / MY_WIN で OS を選ぶ (windmill の HostOs)。windmill のテストは OS の違いを
 * 言語切替 (MY_LCTL) で見るが、ここでは出力表の例外で見る (言語切替は
 * tests/lang-toggle/android-* が見る)。
 *
 * OS で変わるのは US 配列の「」だけ。Microsoft IME は Shift+[ と Shift+] (0x2F 0x30)、
 * Gboard (Android) は Shift+] と Shift+＼ (0x30 0x31)。JIS ではどちらも Shift+] と
 * Shift+＼(0x32) のまま。
 *
 * JIS のまま Android にし、US にし、Windows に戻す。OS と配列は別々に持つので、
 * 片方を変えてももう片方は動かない。こ (左Shift + Shift 面) をホールドする */
#define KAKKO ZMK_MOCK_PRESS(3,5,250) TAP(1,9) TAP(1,10) ZMK_MOCK_RELEASE(3,5,250)

&kscan {
    events = <
        TO_KANA
        CONF_TAP(1,2)
        KAKKO
        CONF_TAP(2,2)
        KAKKO
        CONF_TAP(1,1)
        KAKKO
    >;
};

#include "../../windmill.dtsi"

/* MY_US を選ぶと US 配列で送り、MY_JIS で JIS に戻る
 * (windmill の HostLayoutOutput.output_follows_host_layout)。
 *
 * 記号レイヤーの「@」は JIS では単独の [ のキー (0x2F)、US では Shift+2 (0x1F)。
 * かなの Shift 面の「」は JIS では Shift+] と Shift+＼(0x32)、US (Windows) では
 * Shift+[ と Shift+] (0x2F 0x30)。
 * 「@」は ひ (左の記号)、「」は こ (左Shift + Shift 面) をホールドする */
#define AT ZMK_MOCK_PRESS(3,4,250) TAP(1,2) ZMK_MOCK_RELEASE(3,4,250)
#define KAKKO ZMK_MOCK_PRESS(3,5,250) TAP(1,9) TAP(1,10) ZMK_MOCK_RELEASE(3,5,250)

&kscan {
    events = <
        TO_KANA
        CONF_TAP(2,2)
        AT KAKKO
        CONF_TAP(2,1)
        AT KAKKO
    >;
};

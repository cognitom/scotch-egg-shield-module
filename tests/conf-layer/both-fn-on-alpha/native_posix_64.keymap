#include "../../windmill.dtsi"

/* 英数ベースで左右の Fn を両方押している間は設定レイヤー (windmill の
 * ConfLayerAlpha.both_fn_reach_conf_layer)。MY_ANDR を叩いてもホストへは何も出ず、
 * 続く言語切替 (英数からのタップ) が Android の変換 (0x8A) になる */
&kscan {
    events = <
        CONF_TAP(1,2)
        TAP(3,0)
    >;
};

#include "../../windmill.dtsi"

/* Android でも、かなベースの記号レイヤーの数字は LANG2 / LANG1 で一時的に英数へ
 * 切り替えて送る (windmill の LangToggleAndroid.kana_symbol_still_uses_lng)。
 * 言語切替の変換 / 無変換と混ざらないこと。も (右の記号) をホールドする */
&kscan {
    events = <
        CONF_TAP(1,2)
        TO_KANA
        ZMK_MOCK_PRESS(3,7,50)
        ZMK_MOCK_PRESS(0,1,60)
        ZMK_MOCK_RELEASE(0,1,60)
        ZMK_MOCK_RELEASE(3,7,60)
    >;
};

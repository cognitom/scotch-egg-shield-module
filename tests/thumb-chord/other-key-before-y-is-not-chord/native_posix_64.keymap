#include "../../windmill.dtsi"

/* X↓0 わ↓10 わ↑15 Y↓20 Y↑70 X↑80 → X わ Y (windmill の
 * ThumbChordTest.other_key_before_y_is_not_chord)。Y を押す前に押したほかのキーも
 * 同時押しを止める。こ→み と み→こ を続けて流す */
&kscan {
    events = <
        TO_KANA
        DN_GAP(3,5,10)
        DN_GAP(0,10,5)
        UP_GAP(0,10,5)
        DN_GAP(3,6,50)
        UP_GAP(3,6,10)
        UP_GAP(3,5,300)

        DN_GAP(3,6,10)
        DN_GAP(0,10,5)
        UP_GAP(0,10,5)
        DN_GAP(3,5,50)
        UP_GAP(3,5,10)
        UP_GAP(3,6,300)
    >;
};

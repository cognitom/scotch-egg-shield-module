#include "../../windmill.dtsi"

/* 境界 (重なり = 時間差)。X↓0 Y↓50 X↑100 Y↑140 → スペース (windmill の
 * ThumbChordTest.x_first_overlap_equals_lag_is_space)。X を先に離したので Y の解放で
 * 決まり、X は離れているので Shift は出ない。こ→み と み→こ を続けて流す */
&kscan {
    events = <
        TO_KANA
        DN_GAP(3,5,50)
        DN_GAP(3,6,50)
        UP_GAP(3,5,40)
        UP_GAP(3,6,300)

        DN_GAP(3,6,50)
        DN_GAP(3,5,50)
        UP_GAP(3,6,40)
        UP_GAP(3,5,300)
    >;
};

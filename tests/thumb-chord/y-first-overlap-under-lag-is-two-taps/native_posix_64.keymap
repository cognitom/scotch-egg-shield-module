#include "../../windmill.dtsi"

/* 境界 (重なり = 時間差 - 1)。X↓0 Y↓50 Y↑99 X↑120 → X Y のタップ (windmill の
 * ThumbChordTest.y_first_overlap_under_lag_is_two_taps)。こ→み と み→こ を続けて流す */
&kscan {
    events = <
        TO_KANA
        DN_GAP(3,5,50)
        DN_GAP(3,6,49)
        UP_GAP(3,6,21)
        UP_GAP(3,5,300)

        DN_GAP(3,6,50)
        DN_GAP(3,5,49)
        UP_GAP(3,5,21)
        UP_GAP(3,6,300)
    >;
};

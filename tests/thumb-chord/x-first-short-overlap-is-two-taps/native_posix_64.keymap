#include "../../windmill.dtsi"

/* X↓0 Y↓40 X↑70 Y↑110 → X Y のタップ (windmill の
 * ThumbChordTest.x_first_short_overlap_is_two_taps)。こ→み と み→こ を続けて流す */
&kscan {
    events = <
        TO_KANA
        DN_GAP(3,5,40)
        DN_GAP(3,6,30)
        UP_GAP(3,5,40)
        UP_GAP(3,6,300)

        DN_GAP(3,6,40)
        DN_GAP(3,5,30)
        UP_GAP(3,6,40)
        UP_GAP(3,5,300)
    >;
};

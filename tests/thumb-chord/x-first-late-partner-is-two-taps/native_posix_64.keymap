#include "../../windmill.dtsi"

/* X↓0 Y↓100 X↑130 Y↑200 → X Y のタップ (windmill の
 * ThumbChordTest.x_first_late_partner_is_two_taps)。こ→み と み→こ を続けて流す */
&kscan {
    events = <
        TO_KANA
        DN_GAP(3,5,100)
        DN_GAP(3,6,30)
        UP_GAP(3,5,70)
        UP_GAP(3,6,300)

        DN_GAP(3,6,100)
        DN_GAP(3,5,30)
        UP_GAP(3,6,70)
        UP_GAP(3,5,300)
    >;
};

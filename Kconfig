## Kconfig
```kconfig
# windmill の behavior。キーマップが参照したときだけ有効になる
# (dts/behaviors/windmill.dtsi の /omit-if-no-ref/ でノードごと消えるため)

config ZMK_BEHAVIOR_WM_CHAR
    bool
    default y
    depends on DT_HAS_ZMK_BEHAVIOR_WM_CHAR_ENABLED
    select ZMK_WINDMILL

config ZMK_BEHAVIOR_WM_HOST
    bool
    default y
    depends on DT_HAS_ZMK_BEHAVIOR_WM_HOST_ENABLED
    select ZMK_WINDMILL

config ZMK_BEHAVIOR_WM_LANG
    bool
    default y
    depends on DT_HAS_ZMK_BEHAVIOR_WM_LANG_ENABLED
    select ZMK_WINDMILL

config ZMK_BEHAVIOR_WM_MOD
    bool
    default y
    depends on DT_HAS_ZMK_BEHAVIOR_WM_MOD_ENABLED
    select ZMK_WINDMILL

config ZMK_BEHAVIOR_WM_ALPHA
    bool
    default y
    depends on DT_HAS_ZMK_BEHAVIOR_WM_ALPHA_ENABLED
    select ZMK_WINDMILL

config ZMK_BEHAVIOR_WM_MO
    bool
    default y
    depends on DT_HAS_ZMK_BEHAVIOR_WM_MO_ENABLED
    select ZMK_WINDMILL

config ZMK_BEHAVIOR_WM_OUT
    bool
    default y
    depends on DT_HAS_ZMK_BEHAVIOR_WM_OUT_ENABLED
    select ZMK_WINDMILL

# behavior どうしで共有する処理 (CMakeLists.txt 参照)。どれか1つでも使えば入る
config ZMK_WINDMILL
    bool
```

## dts/bindings/behaviors/zmk,behavior-wm-alpha.yaml
```yaml
description: |
  windmill の英数レイヤーの記号キー。引数は US 配列のキー。接続先が JIS のとき、
  ; ' \ だけは押されている Shift で送るものを決めて1キー1出力で送る。それ以外は
  &kp と同じく押し離しを流す

compatible: "zmk,behavior-wm-alpha"

include: one_param.yaml
```

## dts/bindings/behaviors/zmk,behavior-wm-bottom.yaml
```yaml
description: |
  windmill のかなレイヤー最下段のタップ・ホールド。引数は dt-bindings/windmill/keys.h の
  KB_*。150ms 未満で離せばタップ、250ms でホールド、150ms 以上で別のキーを押せば
  ホールド。未判定の間に押されたキーは待たせ、押した順に出す。
  ホールドの役割はキーごとに決まっている (つ Win、さ Alt、そ / ね Fn、ひ / も 記号、
  こ / み Shift + Shift 面)。Shift 面の最下段 (KB_XTSU など) は、かなレイヤーの同じ位置の
  キーと同じ役割で、タップで出るものだけが変わる

compatible: "zmk,behavior-wm-bottom"

include: one_param.yaml
```

## dts/bindings/behaviors/zmk,behavior-wm-char.yaml
```yaml
description: |
  windmill の文字キー。引数は windmill のキー (dt-bindings/windmill/keys.h の
  KN_* / SY_* / KB_*)。押した瞬間に押し離しを送り切り、リピートしない

compatible: "zmk,behavior-wm-char"

include: one_param.yaml
```

## dts/bindings/behaviors/zmk,behavior-wm-host.yaml
```yaml
description: |
  windmill の接続先の設定のキー (MY_WIN / MY_ANDR / MY_JIS / MY_US)。引数は
  dt-bindings/windmill/host.h の MY_*。いま繋がっている接続先の OS か配列を選んで
  保存する。ホストへは何も送らない

compatible: "zmk,behavior-wm-host"

include: one_param.yaml
```

## dts/bindings/behaviors/zmk,behavior-wm-lang.yaml
```yaml
description: |
  windmill の言語切替のキー (MY_LCTL のタップ / MY_IME)。引数は
  dt-bindings/windmill/lang.h の MY_*。MY_LANG はかな / 英数のベースを入れ替えて
  ホストの IME も切り替え、MY_IME はホストの IME だけを今のベースの側へ切り替える

compatible: "zmk,behavior-wm-lang"

include: one_param.yaml
```

## dts/bindings/behaviors/zmk,behavior-wm-mo.yaml
```yaml
description: |
  windmill の左右の Fn と記号レイヤーのキー。引数は dt-bindings/windmill/layers.h の
  WM_FN_L / WM_FN_R / WM_SYM_L / WM_SYM_R。押している間そのレイヤーを上げ、左右を
  1ビットずつ覚えて、両方離れるまで下ろさない。左右の Fn を両方押している間は
  設定レイヤーも上げる

compatible: "zmk,behavior-wm-mo"

include: one_param.yaml
```

## dts/bindings/behaviors/zmk,behavior-wm-mod.yaml
```yaml
description: |
  windmill の、ホールド中は英数レイヤーを上げる修飾キー (Ctrl / Win / Alt)。引数は
  修飾のキー (LCTRL / LGUI / LALT など)。修飾は &kp と同じく押し離しを流し、かなベースの
  ときだけ押している間は英数レイヤーを上げる

compatible: "zmk,behavior-wm-mod"

include: one_param.yaml
```

## dts/bindings/behaviors/zmk,behavior-wm-out.yaml
```yaml
description: |
  windmill の接続先を選ぶキー (geonix41 の MD_USB / MD_BLE1〜3 / MD_24G)。引数は
  dt-bindings/windmill/host.h の WM_USB / WM_BLE_0〜3。送り先の切替とプロファイルの
  選択を1キーで行い、USB が繋がっていても押した接続先へ移る

compatible: "zmk,behavior-wm-out"

include: one_param.yaml
```
